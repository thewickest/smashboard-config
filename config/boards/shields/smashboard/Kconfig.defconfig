## config/boards/shields/smashboard/Kconfig.defconfig
```kconfig
if SHIELD_SMASHBOARD_LEFT

# Name must be less than 16 characters long!
config ZMK_KEYBOARD_NAME
    default "Smashboard"

config ZMK_SPLIT_ROLE_CENTRAL
    default y

endif

if SHIELD_SMASHBOARD_LEFT || SHIELD_SMASHBOARD_RIGHT

config ZMK_SPLIT
    default y

endif
```

## config/boards/shields/smashboard/Kconfig.shield
```kconfig
config SHIELD_SMASHBOARD_LEFT
    def_bool $(shields_list_contains,smashboard_left)

config SHIELD_SMASHBOARD_RIGHT
    def_bool $(shields_list_contains,smashboard_right)
```
